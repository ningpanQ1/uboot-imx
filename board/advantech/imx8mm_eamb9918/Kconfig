## board/advantech/imx8mm_eamb9918/Kconfig
```kconfig
if TARGET_ADV_EAMB9918

config SYS_BOARD
	default "imx8mm_eamb9918"

config SYS_VENDOR
	default "advantech"

config SYS_CONFIG_NAME
	default "imx8mm_eamb9918"

config IMX_CONFIG
	default "board/advantech/imx8mm_eamb9918/imximage-8mm.cfg"

source "board/freescale/common/Kconfig"

endif
```
